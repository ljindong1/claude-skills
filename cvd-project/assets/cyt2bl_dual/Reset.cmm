B::

sys.DOWN 
sys.UP
sys.OPTION DUALPORT ON
system.Option.IMASKASM On
system.Option.IMASKHLL On
List
go main

ENDDO